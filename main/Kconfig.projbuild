## main/Kconfig.projbuild
```kconfig
menu "Example Configuration"

    config BROKER_URI
        string "Broker URL"
        default "mqtts://mqtt.eclipseprojects.io:8883"
        help
            URL of an mqtt broker which this example connects to.

    config BROKER_CERTIFICATE_OVERRIDE
        string "Broker certificate override"
        default ""
        help
            Please leave empty if broker certificate included from a textfile; otherwise fill in a base64 part of PEM
            format certificate

    config BROKER_CERTIFICATE_OVERRIDDEN
        bool
        default y if BROKER_CERTIFICATE_OVERRIDE != ""

    config BROKER_BIN_SIZE_TO_SEND
        # This option is not visible and is used only to set parameters for example tests
        # Here we configure the data size to send and to be expected in the python script
        int
        default 20000

        choice EXAMPLE_I2C_ADDRESS
        prompt "Select I2C address"
        default EXAMPLE_I2C_ADDRESS_LOW
        help
            Select I2C address

        config EXAMPLE_I2C_ADDRESS_LOW
            bool "MPU6050_I2C_ADDRESS_LOW"
            help
                Choose this when ADDR pin is connected to ground
        config EXAMPLE_I2C_ADDRESS_HIGH
            bool "MPU6050_I2C_ADDRESS_HIGH"
            help
                Choose this when ADDR pin is connected to VCC
    endchoice

    config EXAMPLE_SCL_GPIO
        int "MPU6050 SCL GPIO Number"
        default 5 if IDF_TARGET_ESP8266
        default 4 if IDF_TARGET_ESP32C2 || IDF_TARGET_ESP32C3 || IDF_TARGET_ESP32C5 || IDF_TARGET_ESP32C6 || IDF_TARGET_ESP32C61
        default 4 if IDF_TARGET_ESP32H2
        default 4 if IDF_TARGET_ESP32P4
        default 22 if IDF_TARGET_ESP32 || IDF_TARGET_ESP32S2 || IDF_TARGET_ESP32S3
        help
            GPIO number for I2C Master clock line.

    config EXAMPLE_SDA_GPIO
        int "MPU6050 SDA GPIO Number"
        default 4 if IDF_TARGET_ESP8266
        default 5 if IDF_TARGET_ESP32C2 || IDF_TARGET_ESP32C3 || IDF_TARGET_ESP32C5 || IDF_TARGET_ESP32C6 || IDF_TARGET_ESP32C61
        default 5 if IDF_TARGET_ESP32H2
        default 5 if IDF_TARGET_ESP32P4
        default 21 if IDF_TARGET_ESP32 || IDF_TARGET_ESP32S2 || IDF_TARGET_ESP32S3
        help
            GPIO number for I2C Master data line.

endmenu
```
